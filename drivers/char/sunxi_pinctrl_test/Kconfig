## drivers/char/sunxi_pinctrl_test/Kconfig
```kconfig
#
# sunxi pinctrl test configuration.
#
config SUNXI_PINCTRL_TEST
	tristate "sunxi pinctrl test driver"
	default m
	help
	  Nothing help.
```

## drivers/power/axp_power/Kconfig
```kconfig
menuconfig AW_AXP
	bool "AXP Power drivers"
	depends on REGULATOR
	default y
	---help---
	This option allows you to select AXP power driver

if AW_AXP

config AW_AXP22
	bool "AXP22 driver"
	depends on SUNXI_ARISC
	---help---
	AXP22 driver

config AW_AXP15
	bool "AXP15 driver"
	depends on SUNXI_ARISC
	---help---
	AXP15 driver

config AXP_CHARGEINIT
	bool "AXP initial charging environment set"
	default y

config AXP_CHGCHANGE
	bool "AXP charging current set when suspend\resume\shutdown"
	default y

config AXP_TWI_USED
	bool "AXP use twi as transfer channel"
	default n
	
endif # !AW_AXP
```

## sound/soc/sunxi/audiocodec/Kconfig
```kconfig
config SND_SUNXI_SOC_AUDIOCODEC
	tristate "Audiocodec for the SUNXI chips"
	select SND_SOC_DMAENGINE_PCM
	default n
	help
	  Say Y or M if you want to add support for audiocodec
config SND_SUN8IW1_SNDCODEC
	tristate "Audiocodec for the SUN8IW1 chips"
	depends on ARCH_SUN8IW1
	default n
	help
	  Say Y or M if you want to add sun8iw1 audiocodec support
config SND_SUN8IW3_SNDCODEC
	tristate "Audiocodec for the SUN8IW3 chips"
	depends on ARCH_SUN8IW3
	default n
	help
	  Say Y or M if you want to add sun8iw3 audiocodec support
```

## sound/soc/sunxi/hdmiaudio/Kconfig
```kconfig
config SND_SUNXI_SOC_HDMIAUDIO
	tristate "HDMI Audio for the ReuuiMlla SUNXI chips"
	select SND_SOC_DMAENGINE_PCM
	default n
	help
	  Say Y or M if you want to add support for hdmi audio
```

## sound/soc/sunxi/spdif/Kconfig
```kconfig
config SND_SUNXI_SOC_SPDIF
	tristate "sunxi On-Chip spdif"
	select SND_SOC_DMAENGINE_PCM
	default n
```
